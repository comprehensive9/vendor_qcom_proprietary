/* Copyright (c) 2017, The Linux Foundation. All rights reserved.
 *
 * This program is free software; you can redistribute it and/or modify
 * it under the terms of the GNU General Public License version 2 and
 * only version 2 as published by the Free Software Foundation.
 *
 * This program is distributed in the hope that it will be useful,
 * but WITHOUT ANY WARRANTY; without even the implied warranty of
 * MERCHANTABILITY or FITNESS FOR A PARTICULAR PURPOSE.  See the
 * GNU General Public License for more details.
 */

&mdss_mdp {
	dsi_vq910_dual_xrsmrtvwr_boe_video: qcom,dsi_dual_vq910_boe_video{
		qcom,mdss-dsi-panel-name =
			"vq910 boe video mode dsi panel";
		
		qcom,mdss-dsi-panel-type = "dsi_video_mode";
		qcom,mdss-dsi-virtual-channel-id = <0>;
		qcom,mdss-dsi-stream = <0>;
		qcom,mdss-dsi-panel-hdr-enabled;
		qcom,mdss-dsi-panel-hdr-color-primaries = <14500 15500 32000
			17000 15500 30000 8000 3000>;
		qcom,mdss-dsi-panel-peak-brightness = <4200000>;
		qcom,mdss-dsi-panel-blackness-level = <3230>;

		qcom,dsi-ctrl-num = <0 1>;
		qcom,dsi-phy-num = <0 1>;
		qcom,dsi-select-clocks = "mux_byte_clk0", "mux_pixel_clk0";

		qcom,mdss-dsi-traffic-mode = "non_burst_sync_event";
		qcom,mdss-dsi-bllp-eof-power-mode;
		qcom,mdss-dsi-bllp-power-mode;
		qcom,mdss-dsi-lane-0-state;
		qcom,mdss-dsi-lane-1-state;
		qcom,mdss-dsi-lane-2-state;
		qcom,mdss-dsi-lane-3-state;
		qcom,mdss-dsi-dma-trigger = "trigger_sw";
		qcom,mdss-dsi-mdp-trigger = "none";
		qcom,mdss-dsi-reset-sequence = <1 20>, <0 20>, <1 50>;
		qcom,mdss-pan-physical-width-dimension = <52>;
		qcom,mdss-pan-physical-height-dimension = <52>;
		qcom,mdss-dsi-tx-eot-append;
		qcom,mdss-dsi-color-order = "rgb_swap_rgb";
		qcom,mdss-dsi-underflow-color = <0xff>;
		qcom,mdss-dsi-border-color = <0>;
		qcom,mdss-dsi-bpp = <24>;

		qcom,mdss-dsi-display-timings {
			timing@0{
 				/*1600*1600 param*/
 				qcom,mdss-dsi-panel-width = <1632>;
 				qcom,mdss-dsi-panel-height = <1600>;
 				qcom,mdss-dsi-h-front-porch = <30>;
 				qcom,mdss-dsi-h-back-porch = <21>;
 				qcom,mdss-dsi-h-pulse-width = <1>;
 				qcom,mdss-dsi-h-sync-skew = <2>;
 				qcom,mdss-dsi-v-back-porch = <31>;
 				qcom,mdss-dsi-v-front-porch = <1000>;
 				qcom,mdss-dsi-v-pulse-width = <1>;
				qcom,mdss-dsi-panel-framerate = <72>;
				qcom,mdss-dsi-on-command = [
 				29 01 00 00 00 00 02 B0 04
 				29 01 00 00 00 00 0A B6 30 6B 80 06 33 8A 00 1A 7A

				29 01 00 00 00 00 41 B9 0D F0 03 78 00 00 00 00 05 
				   DC 00 C8 00 00 00 00 05 DC 
				   00 C8 00 00 00 00 05 DC 00 
				   C8 00 00 00 00 05 DC 00 C8 
				   00 00 00 00 05 DC 00 C8 00 
				   00 00 00 05 DC 00 C8 00 00 
				   00 00 05 DC 00 C8 00 00 00 00
					   
                29 01 00 00 00 00 24 BE 00 00 00 00 00 00 69 00 00
  				   00 00 00 00 00 00 00 00 00 
				   00 00 00 00 00 00 00 01 01 
				   01 01 01 01 01 01 00 00

                29 01 00 00 00 00 19 C1 30 00 00 10 11 00 00 00 22 
				   00 00 05 20 FA 00 08 00 00 
				   00 00 00 00 00 00

                29 01 00 00 00 00 6D C2 01 4E 81 01 00 01 00 00 00
 				   00 00 00 00 00 00 00 01 00 
				   00 00 00 01 4E 02 02 01 01 
				   C1 00 01 00 01 00 00 00 08 
				   00 00 01 4E 02 02 01 00 01 
				   00 20 00 23 00 00 00 08 00 
				   00 01 4E 02 02 01 01 00 06 
				   67 06 6A 00 00 00 08 00 00 
				   00 00 00 00 00 00 00 00 00 
				   00 00 00 00 00 00 00 00 00 
				   00 00 00 00 00 00 00 0F 00 
				   00 00 00 00 00 00 00 00 00
				   

                29 01 00 00 00 00 38 C6 0B 40 06 48 00 00 13 01 FF 
				   00 02 16 16 16 00 00 00 01 
				   40 0C 00 00 00 00 00 00 00 
				   40 00 00 40 06 20 02 19 3F 
				   06 00 00 00 00 00 00 44 00 
				   20 00 00 00 00 00 00 00 00 00			   

 				29 01 00 00 00 00 08 CF	8b 00 80 46 61 00 00
								
 				29 01 00 00 00 00 27 D1	EF EF 33 33 07 03 3B 77 37
 	               77 37 35 33 33 F7 33 03 03
 	               03 36 36 66 6D 0D 0A 30 13
 	               0A 0B 00 C4 C4 28 28 28 28 00 00
 				   
 				29 01 00 00 00 00 02 D6 00
 				
 				29 01 00 00 00 00 81 E6	11 00 00 89 30 80 06 40 06
 				   60 00 08 01 98 01 98 02 00
 	               01 CC 00 20 00 A2 00 05 00
 	               0c 0D B7 10 D3 18 00 10 F0
 	               03 0C 20 00 06 0B 0B 33 0E
 	               1C 2A 38 46 54 62 69 70 77
 	               79 7B 7D 7E 01 02 01 00 09
 	               40 09 BE 19 FC 19 FA 19 F8
 	               1A 38 1A 78 1A B6 2A F6 2B
 				   34 2B 74 3B 74 6B F4 00 00
 	               00 00 00 00 00 00 00 00 00
 	               00 00 00 00 00 00 00 00 00
 	               00 00 00 00 00 00 00 00 00
 	               00 00 00 00 00 00 00 00 00
 	               00 00
 				29 01 00 00 00 00 06 EC 03 E8 00 00 00
 				15 01 00 00 00 00 02 36 C0
 				15 01 00 00 00 00 02 35 00
 				05 01 00 00 02 00 02 29 00
 				05 01 00 00 80 00 02 11 00				
				];
				qcom,mdss-dsi-off-command = [
					05 01 00 00 32 00 02 28 00
					05 01 00 00 32 00 02 34 00
					05 01 00 00 78 00 02 10 00
					];
				qcom,mdss-dsi-on-command-state = "dsi_lp_mode";
				qcom,mdss-dsi-off-command-state = "dsi_hs_mode";
				qcom,mdss-dsi-h-sync-pulse = <0>;
				qcom,display-topology = <4 4 2>,
										<1 0 2>;
				qcom,default-topology-index = <0>;

				qcom,compression-mode = "dsc";
 				qcom,mdss-dsc-slice-height = <8>;
 				qcom,mdss-dsc-slice-width = <408>;
				qcom,mdss-dsc-slice-per-pkt = <2>;
				qcom,mdss-dsc-bit-per-component = <8>;
				qcom,mdss-dsc-bit-per-pixel = <8>;
				qcom,mdss-dsc-block-prediction-enable;
				
 				qcom,mdss-dsi-panel-phy-timings =  [00 1A 06 06 16 20 07
 										07 07 02 04 00 16 0C];
						
			
			};
		};

	};
};
